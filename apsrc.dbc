VERSION "HIPBNYYYYYYYYYYYYYYYYYYYYYYYYYYYYYYYYYYYYY/4/%%%/4/'%**4YYY///"

NS_ :

BS_:

BU_:

BO_ 402 LaneOffsetCM_000: 8 Vector__XXX
 SG_ offset : 0|32@1- (1,0) [0|100] "cm" Vector__XXX

CM_ SG_ 402 offset "offset in cm";
BA_DEF_  "BusType" STRING ;
BA_DEF_DEF_  "BusType" "";
BA_ "BusType" "CAN";
SIG_VALTYPE_ 402 offset : 1;
